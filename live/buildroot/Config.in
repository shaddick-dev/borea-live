## live/buildroot/Config.in
```kconfig
source "$BR2_EXTERNAL_BOREA_PATH/package/borea/Config.in"
source "$BR2_EXTERNAL_BOREA_PATH/package/limine/Config.in.host"
```

## live/buildroot/package/borea/Config.in
```kconfig
config BR2_PACKAGE_BOREA
	bool "borea"
	depends on BR2_PACKAGE_HOST_RUSTC_TARGET_ARCH_SUPPORTS
	select BR2_PACKAGE_HOST_RUSTC
	help
	  Borea: the installer (borea-live), the readiness tool (borea),
	  and the USB writer (borea-flash).
```

## live/buildroot/package/limine/Config.in.host
```kconfig
config BR2_PACKAGE_HOST_LIMINE
	bool "host limine"
	depends on BR2_HOSTARCH = "x86_64"
	depends on BR2_PACKAGE_LLVM_ARCH_SUPPORTS # host-clang, host-lld
	depends on BR2_HOST_GCC_AT_LEAST_7 # host-llvm
	select BR2_PACKAGE_HOST_LLD
	help
	  The Limine bootloader: BIOS and UEFI binaries for a hybrid
	  ISO, and the host tool that installs its BIOS stage.

	  https://limine-bootloader.org
```
